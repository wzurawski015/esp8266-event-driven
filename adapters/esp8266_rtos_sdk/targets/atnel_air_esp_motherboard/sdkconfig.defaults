## adapters/esp8266_rtos_sdk/targets/atnel_air_esp_motherboard/sdkconfig.defaults
```kconfig
#
# Stage 2A4 board-target defaults for ATNEL AIR ESP Motherboard.
#

# Mission-critical runtime: require static FreeRTOS object allocation.
CONFIG_FREERTOS_SUPPORT_STATIC_ALLOCATION=y
```

## adapters/esp8266_rtos_sdk/targets/wemos_esp_wroom_02_18650/sdkconfig.defaults
```kconfig
#
# Stage 8 board-target defaults for Wemos ESP-WROOM-02 18650.
#

# Mission-critical runtime: require static FreeRTOS object allocation.
CONFIG_FREERTOS_SUPPORT_STATIC_ALLOCATION=y
```
